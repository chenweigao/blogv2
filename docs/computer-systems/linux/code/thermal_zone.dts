thermal-zones {
    cpu_thermal_zone {

        polling-delay-passive = <1000>; //超过阀值轮询时间
        polling-delay = <2000>; //未超阀值轮询时间
        thermal-sensors = <&ths_combine0 0>;

        trips {
            cpu_trip0:t0 {
                temperature = <70>;
                type = "passive";
                hysteresis = <0>;
            };
            cpu_trip1:t1 {
                temperature = <90>;
                type = "passive";
                hysteresis = <0>;
            };
            cpu_trip2:t2 {
                temperature = <100>;
                type = "passive";
                hysteresis = <0>;
            };
            cpu_trip3:t3 {
                temperature = <105>;
                type = "passive";
                hysteresis = <0>;
            };
            cpu_trip4:t4 {
                temperature = <110>;
                type = "passive";
                hysteresis = <0>;
            };
            crt_trip0:t5{
                temperature = <115>;
                type = "critical";
                hysteresis = <0>;
            };
        };

        cooling-maps{
            bind0{
                contribution = <0>;
                trip = <&cpu_trip0>;
                cooling-device = <&cpu_budget_cooling 1 1>;
            };
            bind1{
                contribution = <0>;
                trip = <&cpu_trip1>;
                cooling-device = <&cpu_budget_cooling 2 2>;
            };
            bind2{
                contribution = <0>;
                trip = <&cpu_trip2>;
                cooling-device = <&cpu_budget_cooling 3 3>;
            };
            bind3{
                contribution = <0>;
                trip = <&cpu_trip3>;
                cooling-device = <&cpu_budget_cooling 4 5>;
            };
            bind4{
                contribution = <0>;
                trip = <&cpu_trip4>;
                cooling-device = <&cpu_budget_cooling 6 6>;
            };
        };
};